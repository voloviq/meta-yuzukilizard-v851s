## conf/layer.conf
```bitbake
# We have a conf and classes directory, add to BBPATH
BBPATH .= ":${LAYERDIR}"

# We have recipes-* directories, add to BBFILES
BBFILES += "${LAYERDIR}/recipes*/*/*.bb ${LAYERDIR}/recipes*/*/*.bbappend"

BBFILE_COLLECTIONS += "meta-yuzukilizard-v851s"
BBFILE_PATTERN_meta-yuzukilizard-v851s = "^${LAYERDIR}/"
BBFILE_PRIORITY_meta-yuzukilizard-v851s = "10"

LAYERSERIES_COMPAT_meta-yuzukilizard-v851s = "kirkstone"
```

## conf/machine/yuzukilizard-v851s.conf
```bitbake
#@TYPE: Machine
#@NAME: Yuzuki-Lizard (V851S)
#@DESCRIPTION: Reference machine configuration for Yuzuki-Lizard (V851S)

require conf/machine/include/arm/armv7a/tune-cortexa7.inc
SOC_FAMILY = "sun8i"
MACHINEOVERRIDES =. "${@['', '${SOC_FAMILY}:']['${SOC_FAMILY}' != '']}"

PREFERRED_PROVIDER_virtual/kernel ?= "linux-mainline"
PREFERRED_PROVIDER_virtual/bootloader = "awboot"
EXTRA_IMAGEDEPENDS += "awboot"

KERNEL_IMAGETYPE = "zImage"
KERNEL_DEVICETREE_FILE = "sun8i-v851s-lizard.dtb"
KERNEL_DEVICETREE = "allwinner/${KERNEL_DEVICETREE_FILE}"
IMAGE_BOOT_FILES ?= "\
    ${KERNEL_IMAGETYPE} \
    ${KERNEL_DEVICETREE_FILE} \
    "

MACHINE_ESSENTIAL_EXTRA_RRECOMMENDS = " kernel-modules"
MACHINE_ESSENTIAL_EXTRA_RDEPENDS = "kernel-image kernel-devicetree"

IMAGE_FSTYPES += "tar.bz2 ext4 wic wic.bmap"
IMAGE_INSTALL += "kernel-devicetree kernel-image-zimage"

WKS_FILE ?= "v851s.wks"
WKS_FILE_DEPENDS ?= " \
    mtools-native \
    dosfstools-native \
    virtual/bootloader \
    virtual/kernel \
    "

SERIAL_CONSOLE ?= "115200;ttyS0 115200;ttyGS0"
MACHINE_FEATURES ?= "alsa apm keyboard rtc serial screen usbgadget usbhost vfat"
DISTRO_FEATURES:remove = "pci 3g nfc ptest multiarch wayland vulkan bluetooth procps"
DISTRO_FEATURES:append = "accessibility fontconfig linuxfb tslib"
PACKAGECONFIG_DISTRO:append_pn_qtbase = " linuxfb tslib "
IMAGE_INSTALL:append = " qtbase qtbase-plugins "
```

## wic/v851s.wks
```
# short-description: Create SD card image for Yuzuki-Lizard (V851s) board
# long-description: Creates a partitioned SD card image for Yuzuki-Lizard (V851S) board
# Boot files are located in the first vfat partition.
include v851s-boot.wks

part / --source rootfs --ondisk mmcblk0 --fstype=ext4 --label root --align 4 --use-uuid
```
